## Kconfig
```kconfig
menuconfig SDK_ENABLE_CANMV
    bool "CanMV Components Configuration"
    default n

    if SDK_ENABLE_CANMV
        config SDK_CANMV_COPY_EXAMPLES
            bool "Copy CanMV Examples"
            default y

        source "$(SDK_CANMV_SRC_DIR)/Kconfig.micropython"
        source "$(SDK_CANMV_SRC_DIR)/Kconfig.openmv"

    endif
```

## Kconfig.micropython
```kconfig
menu "CanMV Micropython Components Configurations"
    comment "IDE/REPL UART Configuration"

    choice
        bool "IDE Debug UART"
        default CANMV_REPL_UART_USB

        config CANMV_REPL_UART_USB
            bool "USB CDC (/dev/ttyGS0)"

        config CANMV_REPL_UART_0
            bool "UART 0"

        config CANMV_REPL_UART_1
            bool "UART 1"

        config CANMV_REPL_UART_2
            bool "UART 2"

        config CANMV_REPL_UART_3
            bool "UART 3"

        config CANMV_REPL_UART_4
            bool "UART 4"

    endchoice

    config CANMV_REPL_UART_ID
        int
        default -1 if CANMV_REPL_UART_USB
        default 0  if CANMV_REPL_UART_0
        default 1  if CANMV_REPL_UART_1
        default 2  if CANMV_REPL_UART_2
        default 3  if CANMV_REPL_UART_3
        default 4  if CANMV_REPL_UART_4

    config ENABLE_MODULE_CV_LITE
        bool "Enable CV_Lite Module"
        default y

endmenu
```

## Kconfig.openmv
```kconfig
menu "CanMV OpenMV Components Configurations"

    config CANMV_IDE_SUPPORT
        bool "Enable CanMV IDE Support"
        default y
        help
          Enable the CanMV IDE debug protocol over the selected REPL UART.
          When disabled, only the REPL is available on the
          selected UART. Hardware UARTs support the command/file/terminal
          protocol but not high-throughput frame dump.

    comment "FB Configuration"

    config CANMV_OPENMV_CFG_FB_ALLOC_SIZE
        hex "OpenMV FB Alloc Max Size"
        default 0x600000
    config CANMV_OPENMV_CFG_FB_ALLOC_COUNT
        int "OpenMV FB Alloc Buffer Count"
        default 256

endmenu
```
